## iot/ble_spp_server/main/Kconfig.projbuild
```kconfig
menu "Sensor Monitor Example"
    config SENSOR_EXAMPLE_PERIOD
        int "sensor min delay(ms)"
        range 0 65535
        default 200
endmenu

menu "Sensor Buffer Size"
    config SENSOR_BUFFER_SIZE
        int "sensor buffer size"
        range 0 65535
        default 2048
endmenu
```

## main/Kconfig.projbuild
```kconfig
menu "FPMemory_BLE Configuration"

    menu "I2C Master"
        config I2C_MASTER_SCL
            int "SCL GPIO Num"
            default 23
            help
                GPIO number for I2C Master clock line.

        config I2C_MASTER_SDA
            int "SDA GPIO Num"
            default 22
            help
                GPIO number for I2C Master data line.

        config I2C_MASTER_PORT_NUM
            int "Port Number"
            default 1
            help
                Port number for I2C Master device.

        config I2C_MASTER_FREQUENCY
            int "Master Frequency"
            default 100000
            help
                I2C Speed of Master device.
    endmenu

    menu "I2C Sensor"       
        
        config I2C_IMU_ADDRESS
            hex "IMU Slave Address"
            default 0x50
            help
                Hardware Address of IMU I2CPort.

        config I2C_ADC_ADDRESS
            hex "AD7998 Slave Address"
            default 0x21
            help
                Hardware Address of AD7998 I2CPort.
        config GPIO_AD799X_CONVST
            int "AD7998 Logic Input Signal IO"
            default 4
            help
                Hardware GPIO for AD7998 Logic Input Signal,high level is enable.
    endmenu    

endmenu
```
